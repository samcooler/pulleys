#include "gameconfig.h"
#include "gamestate.h"
#include "devices.h"

#include <WiFi.h>
#include <pulleys_mesh.h>
#include <WebServer.h>
#include <LittleFS.h>
#include <esp_wifi.h>
#include <game_default.h>   // generated by tools/embed_game.py

#define GAMECFG_PREFIX "  [GAME]"

static const char* GAMECFG_SSID = "pulleys-arbiter";
static const char* GAMECFG_PASS = "pulleyspulleys";
static const char* GAMECFG_PATH = "/game.json";
static const uint16_t GAMECFG_PORT = 8080;
static const size_t   GAMECFG_MAX_BYTES = 16 * 1024;

static WebServer* s_server = nullptr;
static bool       s_fsOk   = false;

static void loadDefault() {
    String why;
    if (!gamestate_load(String(GAME_DEFAULT_JSON), why))
        Serial.printf(GAMECFG_PREFIX " built-in game is invalid: %s\n", why.c_str());
}

static void handlePost() {
    String body = s_server->arg("plain");   // WebServer's name for a raw body
    if (body.isEmpty()) { s_server->send(400, "text/plain", "empty body"); return; }
    if (body.length() > GAMECFG_MAX_BYTES) { s_server->send(413, "text/plain", "too large"); return; }
    if (!s_fsOk) { s_server->send(500, "text/plain", "no filesystem"); return; }

    String why;
    if (!gamestate_load(body, why)) {
        Serial.printf(GAMECFG_PREFIX " rejected: %s\n", why.c_str());
        s_server->send(400, "text/plain", why);
        return;
    }

    // Live already; failing to keep it only costs the reboot.
    File f = LittleFS.open(GAMECFG_PATH, "w");
    bool kept = f && f.print(body) == body.length();
    if (f) f.close();
    if (!kept) Serial.println(GAMECFG_PREFIX " running, but could not store it");

    s_server->send(200, "text/plain",
                   String(kept ? "ok " : "ok (not stored) ") + gamestate_game());
}

static void handleGet() {
    if (!s_fsOk || !LittleFS.exists(GAMECFG_PATH)) {
        s_server->send(404, "text/plain", "running the built-in game");
        return;
    }
    File f = LittleFS.open(GAMECFG_PATH, "r");
    if (!f) { s_server->send(500, "text/plain", "read failed"); return; }
    s_server->streamFile(f, "application/json");
    f.close();
}

static void handleDelete() {
    if (s_fsOk) LittleFS.remove(GAMECFG_PATH);
    loadDefault();
    s_server->send(200, "text/plain", String("ok ") + gamestate_game());
}

static void handleEvent() {
    String name = s_server->hasArg("name") ? s_server->arg("name") : s_server->arg("plain");
    name.trim();
    if (name.isEmpty()) {
        s_server->send(400, "text/plain", "no event name");
        return;
    }
    // A game event, a device's input ("diorama.door_opened"), or a counter's
    // <name>_reached: the state decides whether it means anything.
    gamestate_input(name.c_str());
    s_server->send(200, "text/plain", String("ok ") + gamestate_state());
}

// GET /params: every param and its value now. POST /params: set one live,
// body "round_time=90" (or form field name/value). Durations are seconds.
static void handleParamsGet() {
    String out = "{";
    for (uint8_t i = 0; i < gamestate_param_count(); i++) {
        if (i) out += ",";
        out += String("\"") + gamestate_param_name(i) + "\":" + String(gamestate_param_value(i), 4);
    }
    s_server->send(200, "application/json", out + "}");
}

static void handleParamsPost() {
    String name, value;
    if (s_server->hasArg("name")) {
        name  = s_server->arg("name");
        value = s_server->arg("value");
    } else {
        String body = s_server->arg("plain");
        body.trim();
        int eq = body.indexOf('=');
        if (eq < 0) eq = body.indexOf(' ');
        if (eq > 0) { name = body.substring(0, eq); value = body.substring(eq + 1); }
    }
    name.trim();
    value.trim();
    if (name.isEmpty() || value.isEmpty()) {
        s_server->send(400, "text/plain", "body: name=value");
        return;
    }
    if (!gamestate_set_param(name.c_str(), value.toFloat())) {
        s_server->send(404, "text/plain", "no tunable param '" + name + "' (one needs a min and a max)");
        return;
    }
    handleParamsGet();
}

// The Overlord's director, through its bridge: MESH_MSG_GAME_PARAM, "<name> <value>".
static void onGameParam(const pulleys::MeshFlood& f, bool /*relayed*/) {
    char body[64];
    uint8_t n = f.len < sizeof(body) - 1 ? f.len : sizeof(body) - 1;
    memcpy(body, f.body, n);
    body[n] = 0;
    char* sp = strchr(body, ' ');
    if (!sp) return;
    *sp = 0;
    if (!gamestate_set_param(body, strtof(sp + 1, nullptr)))
        Serial.printf(GAMECFG_PREFIX " param %s from 0x%04X: not a tunable param\n", body, f.h.originId);
}

static void handleState() {
    char out[192];
    snprintf(out, sizeof(out),
             "{\"game\":\"%s\",\"state\":\"%s\",\"ageMs\":%lu,\"timerLeftMs\":%ld,\"decayRate\":%.4f,\"devices\":",
             gamestate_game(), gamestate_state(), (unsigned long)gamestate_state_age_ms(),
             (long)gamestate_timer_left_ms(), gamestate_decay_rate());
    s_server->send(200, "application/json", String(out) + devices_json() + "}");
}

void gameconfig_init() {
    s_fsOk = LittleFS.begin(true);   // format on first boot
    if (!s_fsOk) Serial.println(GAMECFG_PREFIX " LittleFS mount FAILED");

    // A stored game wins over the built-in one; one that no longer validates
    // (say, a firmware update changed what is valid) falls back to it.
    bool running = false;
    if (s_fsOk && LittleFS.exists(GAMECFG_PATH)) {
        File f = LittleFS.open(GAMECFG_PATH, "r");
        String body = f.readString();
        f.close();
        String why;
        running = gamestate_load(body, why);
        if (!running) Serial.printf(GAMECFG_PREFIX " stored game is invalid: %s\n", why.c_str());
    }
    if (!running) loadDefault();
    pulleys::mesh_on_flood(pulleys::MESH_MSG_GAME_PARAM, onGameParam);

    // AP_STA, not AP: the mesh has to keep running underneath this.
    WiFi.mode(WIFI_AP_STA);
    bool up = WiFi.softAP(GAMECFG_SSID, GAMECFG_PASS, MESH_WIFI_CHANNEL, 0, 4);
    esp_wifi_set_ps(WIFI_PS_NONE);

    uint8_t ch = 0;
    wifi_second_chan_t sec;
    esp_wifi_get_channel(&ch, &sec);
    if (!up) { Serial.println(GAMECFG_PREFIX " softAP FAILED"); return; }
    if (ch != MESH_WIFI_CHANNEL) {
        // The AP landing elsewhere takes the whole mesh with it.
        Serial.printf(GAMECFG_PREFIX " !! AP on ch %d, mesh wants %d\n", ch, MESH_WIFI_CHANNEL);
    }

    s_server = new WebServer(GAMECFG_PORT);
    s_server->on("/config", HTTP_POST, handlePost);
    s_server->on("/config", HTTP_GET, handleGet);
    s_server->on("/config", HTTP_DELETE, handleDelete);
    s_server->on("/event", HTTP_POST, handleEvent);
    s_server->on("/state", HTTP_GET, handleState);
    s_server->on("/params", HTTP_GET, handleParamsGet);
    s_server->on("/params", HTTP_POST, handleParamsPost);
    s_server->begin();
    Serial.printf(GAMECFG_PREFIX " http://%s:%u  (ssid=%s ch=%d)\n",
                  WiFi.softAPIP().toString().c_str(), GAMECFG_PORT, GAMECFG_SSID, ch);
}

void gameconfig_poll() {
    if (s_server) s_server->handleClient();
}
